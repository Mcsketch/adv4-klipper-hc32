## work/n32/klipper-n32g455.defconfig
```kconfig
CONFIG_LOW_LEVEL_OPTIONS=y
CONFIG_MACH_STM32=y
CONFIG_MACH_N32G455=y
CONFIG_STM32_FLASH_START_10000=y
CONFIG_STM32_CLOCK_REF_12M=y
CONFIG_STM32_SERIAL_USART1=y
CONFIG_SERIAL_BAUD=115200
```
